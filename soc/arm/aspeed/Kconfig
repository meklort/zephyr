## soc/arm/aspeed/Kconfig
```kconfig
#
# Copyright (c) 2021 Weidmueller Interface GmbH & Co. KG
# SPDX-License-Identifier: Apache-2.0
#

config SOC_FAMILY_ASPEED
	bool

if SOC_FAMILY_ASPEED

config SOC_FAMILY
	string
	default "aspeed"

source "soc/arm/aspeed/*/Kconfig.soc"

endif # SOC_FAMILY_ASPEED
```

## soc/arm/aspeed/ast2500/Kconfig.defconfig.ast2500
```kconfig
#
# Copyright (c) 2021 Weidmueller Interface GmbH & Co. KG
# SPDX-License-Identifier: Apache-2.0
#

config SOC
	default "AST2500"
	depends on SOC_ASPEED_2500
```

## soc/arm/aspeed/ast2500/Kconfig.defconfig.series
```kconfig
#
# Copyright (c) 2021 Weidmueller Interface GmbH & Co. KG
# SPDX-License-Identifier: Apache-2.0
#

if SOC_SERIES_ASPEED

rsource "Kconfig.defconfig.ast25*"

config SOC_SERIES
	default "ast2500"

config MP_NUM_CPUS
	default 1

endif # SOC_SERIES_ASPEED
```

## soc/arm/aspeed/ast2500/Kconfig.soc
```kconfig
#
# Copyright (c) 2021 Weidmueller Interface GmbH & Co. KG
# SPDX-License-Identifier: Apache-2.0
#
# Device data: comp.
# https://www.xilinx.com/products/silicon-devices/soc/zynq-7000.html#productTable
#

choice
	prompt "AST2500 SoC Selection"
	depends on SOC_SERIES_ASPEED

config SOC_ASPEED_2500
	bool "AST2500"
	help
	  One ARM1176JZS core up to 800 MHz, 

endchoice
```
